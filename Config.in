## Config.in
```kconfig
menu "BSP base external board options"

source "$BR2_EXTERNAL_LINUX_BSP_PATH/package/edk/Config.in"
source "$BR2_EXTERNAL_LINUX_BSP_PATH/package/libbmc/Config.in"

source "$BR2_EXTERNAL_LINUX_BSP_PATH/package/edk/Config.in.host"
source "$BR2_EXTERNAL_LINUX_BSP_PATH/package/fw-tools/Config.in.host"

endmenu
```

## board/ti/am625/layout/rootfs.its
```
/dts-v1/;

/ {
	description = "TI AM62x root filesystem";

	images {
		rootfs {
			description = "Buildroot root filesystem";
			type = "firmware";
			arch = "arm64";
			os = "linux";
			compression = "none";
			hash-1 { algo = "sha256"; };
		};
	};

	configurations {
		default = "conf-1";
		conf-1 {
			description = "TI AM62x root filesystem";
			fw,type = "rootfs";
            fw,hwids = @FW_HWIDS@;
			fw,version = <1>;
			fw,rollback-index = <0>;
			fw,build-time-minutes = <@FW_BUILD_TIME_MINUTES@>;
			firmware = "rootfs";
		};
	};
};
```

## configs/am62x_sdk_defconfig
```kconfig
# Standalone AM62x SDK; build with make sdk in a separate O= directory.
BR2_aarch64=y
BR2_TOOLCHAIN_BUILDROOT_GLIBC=y
BR2_KERNEL_HEADERS_7_0=y
BR2_BINUTILS_VERSION_2_46_X=y
BR2_GCC_VERSION_15_X=y
BR2_TOOLCHAIN_BUILDROOT_CXX=y
BR2_PACKAGE_HOST_GDB=y
BR2_PACKAGE_HOST_GDB_PYTHON3=y
BR2_PACKAGE_HOST_ENVIRONMENT_SETUP=y
BR2_JLEVEL=8
BR2_INIT_NONE=y
BR2_SYSTEM_BIN_SH_NONE=y
# BR2_TARGET_GENERIC_GETTY is not set
# BR2_TARGET_GENERIC_REMOUNT_ROOTFS_RW is not set
# BR2_PACKAGE_BUSYBOX is not set
# BR2_PACKAGE_URANDOM_SCRIPTS is not set
# BR2_TARGET_ROOTFS_TAR is not set
```

## package/bmctool/Config.in
```kconfig
config BR2_PACKAGE_BMCTOOL
	bool "bmctool"
	depends on BR2_TOOLCHAIN_HAS_THREADS
	depends on BR2_USE_MMU
	depends on !BR2_STATIC_LIBS
	help
	  Standalone BMC client library with Redfish, IPMI and PMCP backends.
	  Installs libbmctool.so and the bmctool/bmctool.h public header.

if BR2_PACKAGE_BMCTOOL

config BR2_PACKAGE_BMCTOOL_REDFISH
	bool "Redfish backend"
	default y
	select BR2_PACKAGE_CJSON
	select BR2_PACKAGE_LIBCURL
	select BR2_PACKAGE_LIBCURL_FORCE_TLS
	select BR2_PACKAGE_LIBCURL_OPENSSL
	select BR2_PACKAGE_OPENSSL
	select BR2_PACKAGE_OPENSSL_FORCE_LIBOPENSSL

config BR2_PACKAGE_BMCTOOL_IPMI
	bool "IPMI backend"
	select BR2_PACKAGE_FREEIPMI
	select BR2_PACKAGE_LIBGCRYPT if BR2_PACKAGE_LIBGPG_ERROR_ARCH_SUPPORTS

config BR2_PACKAGE_BMCTOOL_PMCP
	bool "PMCP backend"

endif
```

## package/device-manager/Config.in
```kconfig
config BR2_PACKAGE_DEVICE_MANAGER
    bool "Device Manager device tools"
    depends on BR2_USE_MMU
    help
      Select the firmware and logging tools installed on the device.
      The host tools are selected independently below.

if BR2_PACKAGE_DEVICE_MANAGER

config BR2_PACKAGE_DEVICE_MANAGER_FWCTL
    bool "fwctl firmware management"
    depends on BR2_TOOLCHAIN_HAS_THREADS
    select BR2_PACKAGE_CA_CERTIFICATES
    select BR2_PACKAGE_DTC
    select BR2_PACKAGE_LIBCURL
    select BR2_PACKAGE_LIBCURL_EXTRA_PROTOCOLS_FEATURES
    select BR2_PACKAGE_LIBCURL_FORCE_TLS
    select BR2_PACKAGE_LIBCURL_OPENSSL
    select BR2_PACKAGE_OPENSSL
    select BR2_PACKAGE_OPENSSL_FORCE_LIBOPENSSL
    help
      Install the standalone RAW A/B firmware controller and health checks.

config BR2_PACKAGE_DEVICE_MANAGER_FWCTLD
    bool "fwctld OTA agent"
    depends on BR2_PACKAGE_DEVICE_MANAGER_FWCTL
    select BR2_PACKAGE_LIBCURL_CURL
    help
      Install the OTA polling, download, installation and reporting daemon.
      Requires sha256sum in BusyBox for firmware validation.

config BR2_PACKAGE_DEVICE_MANAGER_LOGCTL
    bool "logctl / logctld boot logs"
    select BR2_PACKAGE_LIBCURL
    select BR2_PACKAGE_CA_CERTIFICATES
    help
      Install bounded per-boot logging and optional HTTP(S) forwarding.
      Existing storage is mounted but never formatted during boot.

config BR2_PACKAGE_DEVICE_MANAGER_FWCTL_FIT_SIGNATURE
    bool "fwctl FIT signature verifier"
    depends on BR2_PACKAGE_DEVICE_MANAGER_FWCTL
    select BR2_PACKAGE_UBOOT_TOOLS
    select BR2_PACKAGE_UBOOT_TOOLS_FIT_SUPPORT
    select BR2_PACKAGE_UBOOT_TOOLS_FIT_SIGNATURE_SUPPORT
    select BR2_PACKAGE_UBOOT_TOOLS_FIT_CHECK_SIGN

endif
```

## package/device-manager/Config.in.host
```kconfig
config BR2_PACKAGE_HOST_DEVICE_MANAGER
    bool "host Device Manager tools"
    help
      Select tools built for the development host from the same source.

if BR2_PACKAGE_HOST_DEVICE_MANAGER

config BR2_PACKAGE_HOST_DEVICE_MANAGER_SERVER
    bool "device-server"
    default y
    help
      Install the Device Manager Web and OTA server to host/bin.

config BR2_PACKAGE_HOST_DEVICE_MANAGER_OTA_CLI
    bool "ota-cli"
    default y
    help
      Install the OTA publication CLI to host/bin.

endif
```

## package/device-server/Config.in.host
```kconfig
config BR2_PACKAGE_HOST_DEVICE_SERVER
    bool "host device-server (Device Manager)"
    help
      Build the C device management server and OTA CLI for the build host.
      Installs host/bin/device-server and host/bin/ota-cli, never target tools.
```

## package/edk/Config.in
```kconfig
config BR2_PACKAGE_EDK
	bool "edk"
	depends on BR2_TOOLCHAIN_HAS_THREADS
	depends on BR2_USE_MMU
	help
	  EDK is a Linux embedded device kit with a
	  Kconfig+CMake/Kbuild build system. It provides the PDM kernel
	  module, the shared PDI userspace library, UAPI headers, and
	  optional PDI tools such as pdebug and pdi_claim_test.

if BR2_PACKAGE_EDK

config BR2_PACKAGE_EDK_PDM
	bool "PDM kernel module"
	depends on BR2_LINUX_KERNEL
	default y

config BR2_PACKAGE_EDK_DEFCONFIG
	string "Kconfig defconfig to use"
	default "management_base_defconfig"
	help
	  Specify which EDK defconfig to load before building.
	  Product external trees should set this to a product-specific
	  EDK defconfig, for example ti_am62x_defconfig. Debug
	  images should use a defconfig that enables CONFIG_PDI,
	  CONFIG_PDEBUG when board-side claim validation is required.

config BR2_PACKAGE_EDK_WEB
	bool "Enable pdebug web debugger dependencies"
	depends on !BR2_STATIC_LIBS
	select BR2_PACKAGE_CJSON
	select BR2_PACKAGE_LIGHTTPD
	help
	  Select this when the EDK preset enables CONFIG_PDEBUG_WEB. Installs
	  lighttpd and cJSON for the browser pdebug adapter. The product overlay
	  supplies the listener, access-key initialization and startup policy.

choice
	prompt "Build type"
	default BR2_PACKAGE_EDK_BUILD_TYPE_RELEASE

config BR2_PACKAGE_EDK_BUILD_TYPE_RELEASE
	bool "Release"

config BR2_PACKAGE_EDK_BUILD_TYPE_DEBUG
	bool "Debug"

config BR2_PACKAGE_EDK_BUILD_TYPE_RELWITHDEBINFO
	bool "RelWithDebInfo"

endchoice

config BR2_PACKAGE_EDK_BUILD_TYPE
	string
	default "Release" if BR2_PACKAGE_EDK_BUILD_TYPE_RELEASE
	default "Debug" if BR2_PACKAGE_EDK_BUILD_TYPE_DEBUG
	default "RelWithDebInfo" if BR2_PACKAGE_EDK_BUILD_TYPE_RELWITHDEBINFO

config BR2_PACKAGE_EDK_INSTALL_HEADERS
	bool "Install development headers"
	default n
	help
	  Install development headers to $(STAGING_DIR)/usr/include/.
	  Only needed for packages that depend on EDK.


config BR2_PACKAGE_EDK_FWCTL
    bool "fwctl firmware management"
    depends on BR2_TOOLCHAIN_HAS_THREADS
    select BR2_PACKAGE_CA_CERTIFICATES
    select BR2_PACKAGE_DTC
    select BR2_PACKAGE_LIBUBOOTENV
    select BR2_PACKAGE_LIBCURL
    select BR2_PACKAGE_LIBCURL_EXTRA_PROTOCOLS_FEATURES
    select BR2_PACKAGE_LIBCURL_FORCE_TLS
    select BR2_PACKAGE_LIBCURL_OPENSSL
    select BR2_PACKAGE_OPENSSL
    select BR2_PACKAGE_OPENSSL_FORCE_LIBOPENSSL
    help
      Install the standalone RAW A/B firmware controller and health checks.

config BR2_PACKAGE_EDK_FWCTLD
    bool "fwctld OTA agent"
    depends on BR2_PACKAGE_EDK_FWCTL
    help
      Install the OTA polling, download, installation and reporting daemon.
      Uses the shared libcurl transfer component for durable downloads.

config BR2_PACKAGE_EDK_LOGCTL
    bool "logctl / logctld boot logs"
    depends on BR2_TOOLCHAIN_HAS_THREADS
    select BR2_PACKAGE_LIBCURL
    select BR2_PACKAGE_OPENSSL
    select BR2_PACKAGE_OPENSSL_FORCE_LIBOPENSSL
    select BR2_PACKAGE_CA_CERTIFICATES
    select BR2_PACKAGE_ZLIB
    help
      Install bounded per-boot logging and optional HTTP(S) forwarding.
      Existing storage is mounted but never formatted during boot.

config BR2_PACKAGE_EDK_FWCTL_FIT_SIGNATURE
    bool "fwctl FIT signature verifier"
    depends on BR2_PACKAGE_EDK_FWCTL
    select BR2_PACKAGE_UBOOT_TOOLS
    select BR2_PACKAGE_UBOOT_TOOLS_FIT_SUPPORT
    select BR2_PACKAGE_UBOOT_TOOLS_FIT_SIGNATURE_SUPPORT
    select BR2_PACKAGE_UBOOT_TOOLS_FIT_CHECK_SIGN

config BR2_PACKAGE_EDK_TIMECTL
    bool "timectl / timectld time management"
    depends on BR2_TOOLCHAIN_HAS_THREADS
    select BR2_PACKAGE_LIBCURL
    select BR2_PACKAGE_OPENSSL
    select BR2_PACKAGE_OPENSSL_FORCE_LIBOPENSSL
    select BR2_PACKAGE_CA_CERTIFICATES
    help
      Install independent NTP/HTTP time synchronization, RTC updates,
      local status/control and Device Manager time-source reporting.

endif # BR2_PACKAGE_EDK

comment "EDK needs a toolchain w/ threads, MMU"
	depends on !BR2_TOOLCHAIN_HAS_THREADS || \
		!BR2_USE_MMU
```

## package/edk/Config.in.host
```kconfig
config BR2_PACKAGE_HOST_EDK
    bool "host Device Manager tools"
    help
      Select tools built for the development host from the same source.

if BR2_PACKAGE_HOST_EDK

config BR2_PACKAGE_HOST_EDK_DMSERVER
    bool "dmserver"
    default y
    help
      Install the Device Manager Web and OTA server to host/bin.

config BR2_PACKAGE_HOST_EDK_DMCLI
    bool "dmcli"
    default y
    help
      Install dmcli with OTA upload, publication and query subcommands to host/bin.

endif
```

## package/fw-recovery/Config.in
```kconfig
config BR2_PACKAGE_FW_RECOVERY
    bool "fw-init initramfs recovery"
    depends on BR2_USE_MMU
    depends on BR2_TOOLCHAIN_HAS_THREADS
    depends on BR2_PACKAGE_EDK_FW
    select BR2_PACKAGE_LIBCURL_CURL
    select BR2_PACKAGE_OPENSSL
    help
      C PID 1 for verified rootfs A/B boot and exact offline rootfs recovery.
      Embedded into kernel FIT by the AM625 post-image builder.
```

## package/fw-tools/Config.in.host
```kconfig
config BR2_PACKAGE_HOST_FW_TOOLS
    bool "native firmware image tools"
    help
      Host C tools and jq used by the BSP post-image hooks. Nothing from
      this package is installed on the target or used by Device Manager.
```

## package/fwctl/Config.in
```kconfig
config BR2_PACKAGE_FWCTL
    bool "fwctl firmware management"
    depends on BR2_USE_MMU
    depends on BR2_TOOLCHAIN_HAS_THREADS
    select BR2_PACKAGE_CA_CERTIFICATES
    select BR2_PACKAGE_DTC
    select BR2_PACKAGE_LIBCURL
    select BR2_PACKAGE_LIBCURL_EXTRA_PROTOCOLS_FEATURES
    select BR2_PACKAGE_LIBCURL_FORCE_TLS
    select BR2_PACKAGE_LIBCURL_OPENSSL
    select BR2_PACKAGE_OPENSSL
    select BR2_PACKAGE_OPENSSL_FORCE_LIBOPENSSL
    help
      Standalone Device Manager RAW A/B firmware controller and health checks.

config BR2_PACKAGE_FWCTL_FIT_SIGNATURE
    bool "fwctl FIT signature verifier"
    depends on BR2_PACKAGE_FWCTL
    select BR2_PACKAGE_UBOOT_TOOLS
    select BR2_PACKAGE_UBOOT_TOOLS_FIT_SUPPORT
    select BR2_PACKAGE_UBOOT_TOOLS_FIT_SIGNATURE_SUPPORT
    select BR2_PACKAGE_UBOOT_TOOLS_FIT_CHECK_SIGN
```

## package/fwctld/Config.in
```kconfig
config BR2_PACKAGE_FWCTLD
	bool "fwctld"
	depends on BR2_USE_MMU
	depends on BR2_PACKAGE_EDK_FW
	select BR2_PACKAGE_LIBCURL_CURL
	help
	  C firmware daemon for BSP OTA publications. Downloads and verifies
	  releases, optionally invokes fwctl to install and reboot, and reports
	  boot health results. Requires sha256sum (enabled in the AM62x
	  BusyBox config). Configure /etc/default/fwctld.
```

## package/libbmc/Config.in
```kconfig
config BR2_PACKAGE_LIBBMC
	bool "libbmc"
	depends on BR2_TOOLCHAIN_HAS_THREADS
	depends on BR2_USE_MMU
	depends on !BR2_STATIC_LIBS
	help
	  Standalone BMC client library with Redfish, IPMI and PMCP backends.
	  Installs libbmc.so and the bmc/bmc.h public header.

if BR2_PACKAGE_LIBBMC

config BR2_PACKAGE_LIBBMC_COLLECTOR
	bool "periodic collector"
	default y
	help
	  Build the optional bounded periodic collection scheduler. Disable this
	  when only synchronous collection and snapshot APIs are required.

config BR2_PACKAGE_LIBBMC_REDFISH
	bool "Redfish backend"
	default y
	select BR2_PACKAGE_CJSON
	select BR2_PACKAGE_LIBCURL
	select BR2_PACKAGE_LIBCURL_FORCE_TLS
	select BR2_PACKAGE_LIBCURL_OPENSSL
	select BR2_PACKAGE_OPENSSL
	select BR2_PACKAGE_OPENSSL_FORCE_LIBOPENSSL

config BR2_PACKAGE_LIBBMC_IPMI
	bool "IPMI backend"
	select BR2_PACKAGE_FREEIPMI
	select BR2_PACKAGE_LIBGCRYPT if BR2_PACKAGE_LIBGPG_ERROR_ARCH_SUPPORTS

config BR2_PACKAGE_LIBBMC_PMCP
	bool "PMCP backend"

endif
```

## package/logctl/Config.in
```kconfig
config BR2_PACKAGE_LOGCTL
    bool "logctl / logctld device boot logs"
    depends on BR2_USE_MMU
    select BR2_PACKAGE_LIBCURL
    select BR2_PACKAGE_CA_CERTIFICATES
    help
      Bounded per-boot logging, early boot handoff, pstore archival, export
      and optional authenticated HTTP(S) log forwarding.
      Mount existing storage only; never formats a device during boot.
```

## package/ota-agent/Config.in
```kconfig
config BR2_PACKAGE_OTA_AGENT
	bool "ota-agent"
	depends on BR2_USE_MMU
	depends on BR2_PACKAGE_EDK_FW
	select BR2_PACKAGE_LIBCURL_CURL
	help
	  C polling client for BSP OTA publications. Downloads and verifies
	  releases without flashing or rebooting. Requires sha256sum (enabled
	  in the AM62x BusyBox config). Configure /etc/default/ota-agent.
```
